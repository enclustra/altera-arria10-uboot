## uboot-socfpga/board/altera/socfpga_arria10/Kconfig
```kconfig
if TARGET_SOCFPGA_ARRIA10

config SYS_CPU
	default "armv7"

config SYS_BOARD
	default "socfpga_arria10"

config SYS_VENDOR
	default "altera"

config SYS_SOC
	default "socfpga_arria10"

config SYS_CONFIG_NAME
	default "socfpga_arria10"

config AA1_MODULE_REV1
	bool "Mercury AA1 Rev1"
	default n
	help
		Enable this option when building for Mercury AA1 Rev1.
config UBOOT_EXE_ON_FPGA
	bool "Support socfpga_arria10_fpga"

endif
```

## uboot-socfpga/configs/socfpga_arria10_emmc_defconfig
```kconfig
+S:CONFIG_ARM=y
+S:CONFIG_TARGET_SOCFPGA_ARRIA10=y
CONFIG_MMC_CFF=y
CONFIG_OF_CONTROL=y
CONFIG_DEFAULT_DEVICE_TREE="socfpga_arria10"
CONFIG_SKIP_LOWLEVEL_INIT=n
CONFIG_CADENCE_QSPI=y
CONFIG_MMC=y
CONFIG_SOCFPGA_DWMMC_BUS_WIDTH=8
```

## uboot-socfpga/configs/socfpga_arria10_qspi_defconfig
```kconfig
+S:CONFIG_ARM=y
+S:CONFIG_TARGET_SOCFPGA_ARRIA10=y
CONFIG_CADENCE_QSPI_CFF=y
CONFIG_OF_CONTROL=y
CONFIG_DEFAULT_DEVICE_TREE="socfpga_arria10_qspi"
CONFIG_SKIP_LOWLEVEL_INIT=n
CONFIG_CADENCE_QSPI=y
```

## uboot-socfpga/configs/socfpga_arria10_rev1_emmc_defconfig
```kconfig
+S:CONFIG_ARM=y
+S:CONFIG_TARGET_SOCFPGA_ARRIA10=y
CONFIG_OF_CONTROL=y
CONFIG_AA1_MODULE_REV1=y
CONFIG_DEFAULT_DEVICE_TREE="socfpga_arria10"
CONFIG_SKIP_LOWLEVEL_INIT=n
CONFIG_CADENCE_QSPI=y
CONFIG_MMC=y
CONFIG_SOCFPGA_DWMMC_BUS_WIDTH=8
```

## uboot-socfpga/drivers/mmc/Kconfig
```kconfig
config MMC
        bool "Include MMC driver"
        default n

config SOCFPGA_DWMMC_BUS_WIDTH
        int "DWMMC bus width"
        default 4
```
